#include "commander.h"
#include "commander_modules.h"   // generated by cmdr — run `cmdr module`
#include "secrets.h"
#include "digits.h"              // generated: scripts/gen-digits.py  (kDigits[10])
#include "freertos/FreeRTOS.h"
#include "freertos/task.h"
#include "freertos/semphr.h"
#include "esp_netif_sntp.h"
#include "esp_http_client.h"
#include "esp_crt_bundle.h"
#include "esp_heap_caps.h"
#include <time.h>
#include <stdlib.h>              // setenv, atoi
#include <string.h>             // strncpy, strcmp
#include <stdio.h>              // snprintf

// Local timezone as a POSIX TZ string — encodes the UTC offset AND the
// daylight-saving rules, so localtime() handles DST switchovers for you. Set
// this to your zone. Examples:
//   US Eastern  "EST5EDT,M3.2.0,M11.1.0"      US Central  "CST6CDT,M3.2.0,M11.1.0"
//   US Mountain "MST7MDT,M3.2.0,M11.1.0"      US Pacific  "PST8PDT,M3.2.0,M11.1.0"
//   UK          "GMT0BST,M3.5.0/1,M10.5.0"    Central EU  "CET-1CEST,M3.5.0,M10.5.0/3"
#ifndef CLOCK_TZ
#define CLOCK_TZ "PST8PDT,M3.2.0,M11.1.0"   // US Pacific
#endif
#define NTP_SERVER     "pool.ntp.org"
#define NTP_RESYNC_MS  (12 * 60 * 60 * 1000)   // re-sync the RTC every 12 hours
#define WEATHER_LAT        "47.66"             // NWS forecast point (near ZIP 98383)
#define WEATHER_LON        "-122.7"
#define WEATHER_REFRESH_MS (30 * 60 * 1000)    // poll the weather every 30 minutes
#define NEWS_COUNT         8                   // headlines to fetch from newsapi.org
#define NEWS_REFRESH_MS    (60 * 60 * 1000)    // refresh headlines hourly
#define NEWS_VSTEP         5                   // panel-5 news vertical scroll px/frame (default; `news speed`)
#define NEWS_VFRAME_MS     30                  // panel-5 news scroll pace (clock tick rate)
#define ROTATE_CLOCK_SECS  300                 // timed rotation: clock dwell (5 min)
#define ROTATE_NEWS_SECS   30                  // timed rotation: news-marquee dwell
#define CLOCK_BRIGHTNESS 25                    // backlight duty 0-255 (dim default)

// Font-clock layout tuning (HH:MM). The colon is drawn as two dots overlaid on
// the hours-ones panel, so it positions independently of the digit.
#define HOURS_SHIFT  20     // shift hours digits left (px) — group HH toward the colon
#define COLON_DOT    12     // colon dot size (px square)
#define COLON_GAP    22     // vertical gap between the two colon dots (px)
#define COLON_X     106     // colon dots' left x within the hours-ones panel (px)

// Marquee tunables — a message scrolling right-to-left across all six panels.
// drawMarquee caches the raster, so the frame cost is the SPI blit, pinned at
// ~40 MHz by the GPIO-matrix routing (SCLK/MOSI aren't IOMUX SPI pins) → ~14 fps
// ceiling. Speed = step_px × fps, so the step is the speed dial. MARQUEE_STEP is
// the default; tune live with `mspeed`/`msize`.
#define MARQUEE_PX            60               // glyph height (shorter band → higher fps)
#define MARQUEE_STEP          10               // default pixels per frame (see mspeed)
#define MARQUEE_FRAME_MS      10               // pace between frames (1 FreeRTOS tick)

// Reader (single-panel vertical scroll) — a long message creeping up one panel.
#define READ_PX               40               // glyph height (several lines per panel)
#define READ_STEP              1               // pixels per frame (slow creep)
#define READ_FRAME_MS         30               // pace between frames

// Single-panel horizontal scroll — one line scrolling left within a panel.
#define HSCROLL_PX           100               // glyph height (one panel is 240 tall)
#define HSCROLL_STEP           4               // pixels per frame
#define HSCROLL_FRAME_MS      12               // pace between frames

extern "C" CommanderConfig commander_config() {
    CommanderConfig cfg;
    cfg.wifi_ssid     = WIFI_SSID;
    cfg.wifi_password = WIFI_PASSWORD;
    cfg.hostname      = "cmdr-ipstube";
    cfg.uart_baud     = 115200;
    cfg.uart_greeting = "cmdr-ipstube";
    return cfg;
}

// ── Shared state ──────────────────────────────────────────────────────────────
static IpstubeModule    *s_disp = nullptr;
static Ds1302Module     *s_rtc  = nullptr;
static SemaphoreHandle_t s_rtc_lock = nullptr;   // DS1302 bit-banged bus: clock + NTP tasks

// Per-scene parameters (set by commands, consumed by the scene's enter/tick).
static char         s_msg[160]    = {0};               // marquee text
static volatile int s_msg_w       = 0;                 // measured width of s_msg
static volatile int s_ax          = 0;                 // marquee scroll anchor
static volatile int s_step        = MARQUEE_STEP;      // marquee px/frame (`mspeed`)
static volatile int s_mpx         = MARQUEE_PX;        // marquee glyph height (`msize`)
static char         s_read_msg[256] = {0};             // reader text
static volatile uint8_t s_read_d  = 0;                 // reader target panel (or kAll)
static volatile int s_read_ay     = 0;                 // reader vertical offset
static volatile int s_read_h      = 0;                 // reader column height (sweep range)
static char         s_hs_msg[256] = {0};               // h-scroll text
static volatile uint8_t s_hs_d    = 0;                 // h-scroll target panel (or kAll)
static volatile int s_hs_ax       = 0;                 // h-scroll offset
static volatile int s_hs_w        = 0;                 // h-scroll text width (wrap point)

static IpstubeModule::TextStyle marquee_style() {
    IpstubeModule::TextStyle st;
    st.px = s_mpx; st.halign = IpstubeModule::TextStyle::Left; st.valign = IpstubeModule::TextStyle::Middle;
    return st;
}
static IpstubeModule::TextStyle read_style() {
    IpstubeModule::TextStyle st;
    st.px = READ_PX; st.halign = IpstubeModule::TextStyle::Left; st.valign = IpstubeModule::TextStyle::Top;
    return st;
}
static IpstubeModule::TextStyle hscroll_style() {
    IpstubeModule::TextStyle st;
    st.px = HSCROLL_PX; st.halign = IpstubeModule::TextStyle::Left; st.valign = IpstubeModule::TextStyle::Middle;
    return st;
}
// measureText only reads font metrics (no cache build), so it's safe off the
// runner task — width is needed by the marquee/h-scroll wrap-around.
static void marquee_remeasure() {
    if (!s_disp || !s_disp->haveFont() || !s_msg[0]) return;
    int w, h; s_disp->measureText(s_msg, marquee_style(), &w, &h);
    s_msg_w = w;
}

// ── Scene framework ───────────────────────────────────────────────────────────
// A scene owns what's on the glass. A single scene_runner task ticks the active
// scene; switching is just pointing at a new one (commands set s_pending). Because
// only the runner draws, no display mutex is needed and all cache-building (raster)
// happens on one task. enter() prepares the canvas; tick() draws one frame and
// returns the ms until the next tick.
struct Scene {
    const char *name;
    void (*enter)();
    int  (*tick)();
};
static const Scene *s_scene   = nullptr;   // active (runner-owned)
static const Scene *s_pending = nullptr;   // requested switch (command → runner)
static void scene_request(const Scene *sc) { s_pending = sc; }

static void scene_runner(void *) {
    for (;;) {
        const Scene *nx = s_pending;
        if (nx) {
            s_pending = nullptr;
            s_scene = nx;
            if (nx->enter) nx->enter();
        }
        int delay = 100;
        if (s_scene && s_scene->tick) delay = s_scene->tick();
        if (delay < 1) delay = 1;
        vTaskDelay(pdMS_TO_TICKS(delay));
    }
}

// ── Clock scene ───────────────────────────────────────────────────────────────
// Display mapping, left-to-right: 0 = hours-tens … 5 = seconds-ones (HHMMSS).
// 12-hour with leading zero. The DS1302 drives the display; NTP keeps it corrected.
// Clock state. With the font face the layout is HH:MM + a day/date panel (+ a
// weather panel, coming in C2b); the PNG face is the original HHMMSS flip-clock.
// s_clock_last caches per-panel content for dirty-skip (reset on repaint); its
// meaning differs by face (a digit value, or a date key / a drawn flag).
static int  s_clock_last[6]  = {-1, -1, -1, -1, -1, -1};
static volatile bool s_clock_font    = true;    // true = font (default), false = PNG flip-clock
static volatile bool s_clock_repaint = false;   // force a full repaint (set by `face`)
static int  s_digit_px       = 0;               // font digit size (sized so "8:" fits a panel)
static const char *const kWday[8] = {"", "SUN", "MON", "TUE", "WED", "THU", "FRI", "SAT"};

// Live-tunable font-clock layout (seeded from the #defines). Adjust with `tune
// <group> <a> [b]`, print all with bare `tune`. Handy when trying other fonts.
static volatile int s_hours_dx  = -HOURS_SHIFT;             // hours digits x offset from center (+right)
static volatile int s_hours_dy  = 0;                        // hours digits y offset (+down)
static volatile int s_mins_dx   = 0;                        // minutes digits x offset
static volatile int s_mins_dy   = 0;                        // minutes digits y offset
static volatile int s_colon_x   = COLON_X;                  // colon dots' left x (panel px)
static volatile int s_colon_y   = IpstubeModule::kHeight / 2;  // colon group vertical center (panel px)
static volatile int s_colon_sz  = COLON_DOT;               // colon dot size (px)
static volatile int s_colon_gap = COLON_GAP;               // gap between the two dots (px)

static char          s_weather[80]   = "";    // multi-line "NN°F\nCondition\nH.. L.." — weather_task
static volatile bool s_weather_new   = false; // clock redraws panel 5 when this is set
static volatile bool s_weather_fetch_now = false;  // `weather fetch` requests a refresh
static char          s_weather_raw[200]  = "";     // currentobservation snippet (debug)

static char          s_news[1024]    = "";    // joined headlines — set by news_task
static volatile bool s_news_new      = false; // headlines refreshed
static volatile bool s_news_fetch_now = false;// `news fetch` requests an immediate refresh
static volatile bool s_panel5_news   = false; // panel 5: false = weather, true = vertical news
static volatile bool s_p5_dirty      = true;  // rebuild the panel-5 news scroll cache
static int           s_p5_news_ay    = 0;     // panel-5 news vertical offset
static int           s_p5_news_h     = 0;     // panel-5 news column height
static volatile int  s_news_ax       = 0;     // news-marquee scroll anchor
static volatile int  s_news_w        = 0;     // news-marquee text width
static volatile bool s_rotate        = false; // timed scene rotation enabled
static volatile int  s_news_vstep    = NEWS_VSTEP;  // panel-5 news scroll px/frame (`news speed`)
static char          s_news_raw[200]  = "";   // first bytes of the last newsapi response (debug)

static IpstubeModule::TextStyle news_style() {  // panel-5 vertical news
    IpstubeModule::TextStyle st;
    st.px = 36; st.halign = IpstubeModule::TextStyle::Left; st.valign = IpstubeModule::TextStyle::Top;
    return st;
}

static void clock_enter() {
    for (int i = 0; i < 6; i++) s_clock_last[i] = -1;   // force a full repaint
    s_p5_dirty = true;                                  // rebuild panel-5 news cache if shown
}

// PNG flip-clock: HHMMSS, one baked digit per panel.
static void clock_draw_png(const RtcTime &t) {
    int h12 = t.hour % 12;
    if (h12 == 0) h12 = 12;
    int d[6];
    d[0] = h12 / 10;      d[1] = h12 % 10;
    d[2] = t.minute / 10; d[3] = t.minute % 10;
    d[4] = t.second / 10; d[5] = t.second % 10;
    for (int i = 0; i < 6; i++) {
        if (d[i] == s_clock_last[i]) continue;
        if (d[i] < 0 || d[i] > 9) continue;
        s_disp->drawBitmap((uint8_t)i, kDigits[d[i]]);
        s_clock_last[i] = d[i];
    }
}

// The HH:MM colon — two white dots overlaid on the hours-ones panel after its
// digit (drawBitmap doesn't clear the rest), centered vertically on the panel.
static void draw_colon() {
    static uint16_t dot[40 * 40];          // white square, refilled to the live size
    int sz = s_colon_sz;
    if (sz < 2)  sz = 2;
    if (sz > 40) sz = 40;
    for (int i = 0; i < sz * sz; i++) dot[i] = 0xFFFF;
    int x = s_colon_x;
    if (x < 0) x = 0;
    if (x > IpstubeModule::kWidth - sz) x = IpstubeModule::kWidth - sz;
    int top = s_colon_y - s_colon_gap / 2 - sz;
    int bot = s_colon_y + s_colon_gap / 2;
    if (top < 0) top = 0;
    if (bot > IpstubeModule::kHeight - sz) bot = IpstubeModule::kHeight - sz;
    s_disp->drawBitmap(1, x, top, sz, sz, dot);
    s_disp->drawBitmap(1, x, bot, sz, sz, dot);
}

// Font face: panels 0-3 = HH:MM (colon overlaid on the hours-ones panel), panel 4
// = weekday over date, panel 5 = weather placeholder (blank until C2b).
static void clock_draw_font(const RtcTime &t) {
    if (s_digit_px == 0)            // size digits so "8:" (the widest panel) just fits
        s_digit_px = s_disp->fitPx("8:", IpstubeModule::kWidth - 16, IpstubeModule::kHeight - 16);
    int h12 = t.hour % 12;
    if (h12 == 0) h12 = 12;
    int dig[4];
    dig[0] = h12 / 10;      dig[1] = h12 % 10;
    dig[2] = t.minute / 10; dig[3] = t.minute % 10;
    IpstubeModule::TextStyle st;
    st.px = s_digit_px;            // white-on-black; Center/Middle by default
    for (int i = 0; i < 4; i++) {
        if (dig[i] == s_clock_last[i]) continue;
        char s[2];
        s[0] = (char)('0' + dig[i]);
        s[1] = '\0';
        int ax = IpstubeModule::kWidth  / 2 + ((i < 2) ? s_hours_dx : s_mins_dx);
        int ay = IpstubeModule::kHeight / 2 + ((i < 2) ? s_hours_dy : s_mins_dy);
        s_disp->drawText((uint8_t)i, ax, ay, s, st);
        if (i == 1) draw_colon();   // overlay the colon after the hours-ones digit
        s_clock_last[i] = dig[i];
    }
    // Panel 4: weekday over date — redraw only when the date changes.
    int datekey = t.month * 100 + t.day;
    if (s_clock_last[4] != datekey) {
        int wd = (t.weekday >= 1 && t.weekday <= 7) ? t.weekday : 0;
        char buf[16];
        snprintf(buf, sizeof(buf), "%s %d/%d", kWday[wd], t.month, t.day);
        IpstubeModule::TextStyle ds;
        ds.px = 64;                // fixed so it wraps to two centered lines (weekday / M/D)
        s_disp->drawTextWrapped(4, buf, ds);
        s_clock_last[4] = datekey;
    }
    // Panel 5: vertical news scroll (panel5 news), else weather.
    if (s_panel5_news && s_news[0]) {
        if (s_p5_dirty) {
            s_p5_dirty = false;
            s_p5_news_h = s_disp->vscrollHeight(s_news, news_style());
            s_p5_news_ay = -IpstubeModule::kHeight;
        }
        s_disp->drawVScroll(5, s_p5_news_ay, s_news, news_style());
        s_p5_news_ay += s_news_vstep;
        if (s_p5_news_ay > s_p5_news_h) s_p5_news_ay = -IpstubeModule::kHeight;
        s_clock_last[5] = -2;          // mark news-mode so weather repaints when we switch back
    } else if (s_clock_last[5] != 1 || s_weather_new) {
        s_weather_new = false;
        if (s_weather[0]) {
            IpstubeModule::TextStyle ws;
            ws.px = 0;                 // auto-fit the panel (temp + condition)
            s_disp->drawTextWrapped(5, s_weather, ws);
        } else {
            s_disp->fill(5, 0x0000);   // no data yet
        }
        s_clock_last[5] = 1;
    }
}

static int clock_tick() {
    if (s_clock_repaint) {
        for (int i = 0; i < 6; i++) s_clock_last[i] = -1;
        s_clock_repaint = false;
    }
    RtcTime t;
    xSemaphoreTake(s_rtc_lock, portMAX_DELAY);
    s_rtc->getTime(t);
    xSemaphoreGive(s_rtc_lock);
    if (s_clock_font) clock_draw_font(t);
    else              clock_draw_png(t);
    // Tick fast while panel 5 is animating news; otherwise a lazy clock cadence.
    return (s_clock_font && s_panel5_news && s_news[0]) ? NEWS_VFRAME_MS : 250;
}

// ── Marquee scene (cached strip scroll across all six) ─────────────────────────
static void marquee_enter() { s_ax = IpstubeModule::stripWidth(); }
static int marquee_tick() {
    s_disp->drawMarquee(s_ax, s_msg, marquee_style());   // picks up live msize
    s_ax -= s_step;
    if (s_ax < -s_msg_w) s_ax = IpstubeModule::stripWidth();
    return MARQUEE_FRAME_MS;
}

// ── Reader scene (single-panel vertical scroll) ────────────────────────────────
static void read_enter() {
    s_read_h  = s_disp->vscrollHeight(s_read_msg, read_style());   // builds cache (on runner)
    s_disp->fill(IpstubeModule::kAll, 0x0000);                     // blank others
    s_read_ay = -IpstubeModule::kHeight;                           // enter from the bottom
}
static int read_tick() {
    s_disp->drawVScroll(s_read_d, s_read_ay, s_read_msg, read_style());
    s_read_ay += READ_STEP;
    if (s_read_ay > s_read_h) s_read_ay = -IpstubeModule::kHeight;
    return READ_FRAME_MS;
}

// ── H-scroll scene (single-panel horizontal scroll) ────────────────────────────
static void hscroll_enter() {
    s_disp->fill(IpstubeModule::kAll, 0x0000);
    s_hs_ax = IpstubeModule::kWidth;                  // enter from the right edge
}
static int hscroll_tick() {
    s_disp->drawHScroll(s_hs_d, s_hs_ax, s_hs_msg, hscroll_style());
    s_hs_ax -= HSCROLL_STEP;
    if (s_hs_ax < -s_hs_w) s_hs_ax = IpstubeModule::kWidth;
    return HSCROLL_FRAME_MS;
}

// ── News scene (headlines as a full-strip marquee) ─────────────────────────────
static void news_enter() {
    if (s_news[0]) {
        int w, h; s_disp->measureText(s_news, marquee_style(), &w, &h);
        s_news_w = w;
    }
    s_news_ax = IpstubeModule::stripWidth();
    s_disp->fill(IpstubeModule::kAll, 0x0000);
}
static int news_tick() {
    if (!s_news[0]) {                 // no headlines yet — wait for the fetch
        IpstubeModule::TextStyle st = marquee_style();
        s_disp->drawMarquee(IpstubeModule::stripWidth(), "", st);
        return 500;
    }
    s_disp->drawMarquee(s_news_ax, s_news, marquee_style());
    s_news_ax -= s_step;
    if (s_news_ax < -s_news_w) s_news_ax = IpstubeModule::stripWidth();
    return MARQUEE_FRAME_MS;
}

// ── Hold scene (slave/host mode — runner yields; external draws persist) ────────
static int hold_tick() { return 250; }   // draw nothing; whatever was pushed stays

static const Scene kSceneClock   = { "clock",   clock_enter,   clock_tick   };
static const Scene kSceneMarquee = { "marquee", marquee_enter, marquee_tick };
static const Scene kSceneRead    = { "read",    read_enter,    read_tick    };
static const Scene kSceneHScroll = { "hscroll", hscroll_enter, hscroll_tick };
static const Scene kSceneNews    = { "news",    news_enter,    news_tick    };
static const Scene kSceneHold    = { "hold",    nullptr,       hold_tick    };

// ── Commands ──────────────────────────────────────────────────────────────────
// Parse "<d|all> <text>" → display id + the text pointer. false if malformed.
static bool parse_panel_text(const char *args, uint8_t *d, const char **text) {
    while (*args == ' ') ++args;
    char tok[8]; int ti = 0;
    while (*args && *args != ' ' && ti < 7) tok[ti++] = *args++;
    tok[ti] = '\0';
    while (*args == ' ') ++args;
    if (tok[0] == '\0' || *args == '\0') return false;
    if (strcmp(tok, "all") == 0) {
        *d = IpstubeModule::kAll;
    } else {
        int v = atoi(tok);
        if (v < 0 || v >= IpstubeModule::kNumDisplays) return false;
        *d = (uint8_t)v;
    }
    *text = args;
    return true;
}

static void cmd_clock(const char *, Writer &out, void *) {
    scene_request(&kSceneClock);
    out.writeln("ok (clock)");
}

static void cmd_marquee(const char *args, Writer &out, void *) {
    while (*args == ' ') ++args;
    if (*args == '\0')                  { out.writeln("usage: marquee <text>"); return; }
    if (!s_disp || !s_disp->haveFont()) { out.writeln("marquee: display/font not ready"); return; }
    strncpy(s_msg, args, sizeof(s_msg) - 1);
    s_msg[sizeof(s_msg) - 1] = '\0';
    marquee_remeasure();
    scene_request(&kSceneMarquee);
    out.writeln("ok (scrolling — `clock` to return)");
}

static void cmd_read(const char *args, Writer &out, void *) {
    if (!s_disp || !s_disp->haveFont()) { out.writeln("read: display/font not ready"); return; }
    uint8_t d; const char *text;
    if (!parse_panel_text(args, &d, &text)) { out.writeln("usage: read <d|all> <text>"); return; }
    strncpy(s_read_msg, text, sizeof(s_read_msg) - 1);
    s_read_msg[sizeof(s_read_msg) - 1] = '\0';
    s_read_d = d;
    scene_request(&kSceneRead);          // read_enter measures + blanks on the runner
    out.writeln("ok (reading — `clock` to return)");
}

static void cmd_hscroll(const char *args, Writer &out, void *) {
    if (!s_disp || !s_disp->haveFont()) { out.writeln("hscroll: display/font not ready"); return; }
    uint8_t d; const char *text;
    if (!parse_panel_text(args, &d, &text)) { out.writeln("usage: hscroll <d|all> <text>"); return; }
    strncpy(s_hs_msg, text, sizeof(s_hs_msg) - 1);
    s_hs_msg[sizeof(s_hs_msg) - 1] = '\0';
    s_hs_d = d;
    int w, h; s_disp->measureText(s_hs_msg, hscroll_style(), &w, &h);
    s_hs_w = w;
    scene_request(&kSceneHScroll);
    out.writeln("ok (scrolling — `clock` to return)");
}

static void cmd_mode(const char *, Writer &out, void *) {
    out.write("mode: ");
    out.writeln(s_scene ? s_scene->name : "(none)");
}

// Switch the clock face between the baked PNG flip-clock and font-rendered digits.
static void cmd_face(const char *args, Writer &out, void *) {
    while (*args == ' ') ++args;
    char tok[8]; int ti = 0;
    while (*args && *args != ' ' && ti < 7) tok[ti++] = *args++;
    tok[ti] = '\0';
    if (tok[0] == '\0') {
        out.write("face: ");
        out.writeln(s_clock_font ? "font" : "png");
        return;
    }
    if (strcmp(tok, "font") == 0)     s_clock_font = true;
    else if (strcmp(tok, "png") == 0) s_clock_font = false;
    else { out.writeln("usage: face png|font"); return; }
    s_clock_repaint = true;           // repaint with the new face on the next clock tick
    out.writeln(s_clock_font ? "ok (font)" : "ok (png)");
}

// Live font-clock layout tuning. Bare `tune` prints every value (report these
// back). `tune <group> <a> [b]` sets a group and repaints:
//   tune hours <dx> <dy>   tune mins <dx> <dy>   tune colon <x> <y>   tune csize <size> [gap]
static void cmd_tune(const char *args, Writer &out, void *) {
    while (*args == ' ') ++args;
    if (*args == '\0') {
        char b[64];
        snprintf(b, sizeof(b), "hours dx,dy  = %d,%d", s_hours_dx, s_hours_dy); out.writeln(b);
        snprintf(b, sizeof(b), "mins  dx,dy  = %d,%d", s_mins_dx,  s_mins_dy);  out.writeln(b);
        snprintf(b, sizeof(b), "colon x,y    = %d,%d", s_colon_x,  s_colon_y);  out.writeln(b);
        snprintf(b, sizeof(b), "colon sz,gap = %d,%d", s_colon_sz, s_colon_gap); out.writeln(b);
        snprintf(b, sizeof(b), "digit px     = %d (auto)", s_digit_px);          out.writeln(b);
        return;
    }
    char sub[8]; int si = 0;
    const char *p = args;
    while (*p && *p != ' ' && si < 7) sub[si++] = *p++;
    sub[si] = '\0';
    while (*p == ' ') ++p;
    int a = atoi(p);
    const char *q = p;
    while (*q && *q != ' ') ++q;
    while (*q == ' ') ++q;
    bool has_b = (*q != '\0');
    int b = atoi(q);
    if (strcmp(sub, "hours") == 0)      { s_hours_dx = a; if (has_b) s_hours_dy = b; }
    else if (strcmp(sub, "mins") == 0)  { s_mins_dx  = a; if (has_b) s_mins_dy  = b; }
    else if (strcmp(sub, "colon") == 0) { s_colon_x  = a; if (has_b) s_colon_y  = b; }
    else if (strcmp(sub, "csize") == 0) { s_colon_sz = a; if (has_b) s_colon_gap = b; }
    else { out.writeln("usage: tune [hours|mins|colon <x> <y> | csize <size> [gap]]"); return; }
    s_clock_repaint = true;
    out.writeln("ok");
}

// Slave/host mode: yield the displays so external pushes (ipstube text, etc.) persist.
static void cmd_hold(const char *, Writer &out, void *) {
    scene_request(&kSceneHold);
    out.writeln("ok (hold — external draws persist; `clock` to return)");
}

// News: `news` shows headlines as a full marquee; `news fetch` refreshes now.
static void cmd_news(const char *args, Writer &out, void *) {
    while (*args == ' ') ++args;
    if (strncmp(args, "fetch", 5) == 0) {
        s_news_fetch_now = true;
        out.writeln("ok (refreshing headlines)");
        return;
    }
    if (strncmp(args, "raw", 3) == 0) {           // debug: show the newsapi response start
        out.writeln(s_news_raw[0] ? s_news_raw : "(no response yet)");
        return;
    }
    if (strncmp(args, "speed", 5) == 0) {         // panel-5 news vertical-scroll speed
        const char *a = args + 5;
        while (*a == ' ') ++a;
        if (*a) {
            int v = atoi(a);
            if (v < 1)  v = 1;
            if (v > 20) v = 20;
            s_news_vstep = v;
        }
        char b[40]; snprintf(b, sizeof(b), "news speed = %d px/frame", s_news_vstep);
        out.writeln(b);
        return;
    }
    scene_request(&kSceneNews);
    out.writeln(s_news[0] ? "ok (news — `clock` to return)" : "ok (no headlines yet — fetching)");
}

// Panel 5 content while the clock runs: live weather or vertically-scrolling news.
static void cmd_panel5(const char *args, Writer &out, void *) {
    while (*args == ' ') ++args;
    if (strncmp(args, "news", 4) == 0)         s_panel5_news = true;
    else if (strncmp(args, "weather", 7) == 0) s_panel5_news = false;
    else { out.writeln("usage: panel5 weather|news"); return; }
    s_p5_dirty = true;
    s_clock_repaint = true;       // repaint so panel 5 swaps content cleanly
    out.writeln(s_panel5_news ? "ok (panel5 news)" : "ok (panel5 weather)");
}

// Weather: bare shows the current reading; `weather fetch` refreshes; `weather raw` debugs.
static void cmd_weather(const char *args, Writer &out, void *) {
    while (*args == ' ') ++args;
    if (strncmp(args, "fetch", 5) == 0) { s_weather_fetch_now = true; out.writeln("ok (refreshing weather)"); return; }
    if (strncmp(args, "raw", 3) == 0)   { out.writeln(s_weather_raw[0] ? s_weather_raw : "(no response yet)"); return; }
    out.writeln(s_weather[0] ? s_weather : "(no weather yet)");
}

// Timed scene rotation (D1): clock <-> news marquee.
static void cmd_rotate(const char *args, Writer &out, void *) {
    while (*args == ' ') ++args;
    if (strncmp(args, "on", 2) == 0)        s_rotate = true;
    else if (strncmp(args, "off", 3) == 0)  s_rotate = false;
    else { out.writeln(s_rotate ? "rotate: on" : "rotate: off"); return; }
    out.writeln(s_rotate ? "ok (rotating clock <-> news)" : "ok (rotation off)");
}

// Tune the marquee scroll speed live (px per frame). With fps pinned by the SPI
// ceiling, this is the velocity dial; higher = faster but coarser motion.
static void cmd_mspeed(const char *args, Writer &out, void *) {
    while (*args == ' ') ++args;
    if (*args == '\0') {
        char b[40]; snprintf(b, sizeof(b), "mspeed = %d px/frame", s_step);
        out.writeln(b);
        return;
    }
    int v = atoi(args);
    if (v < 1)  v = 1;
    if (v > 60) v = 60;
    s_step = v;
    char b[40]; snprintf(b, sizeof(b), "ok (%d px/frame)", v);
    out.writeln(b);
}

// Tune the marquee font height live. Smaller = shorter band = higher fps.
static void cmd_msize(const char *args, Writer &out, void *) {
    while (*args == ' ') ++args;
    if (*args == '\0') {
        char b[40]; snprintf(b, sizeof(b), "msize = %d px", s_mpx);
        out.writeln(b);
        return;
    }
    int v = atoi(args);
    if (v < 20)  v = 20;
    if (v > 240) v = 240;
    s_mpx = v;
    marquee_remeasure();
    s_ax  = IpstubeModule::stripWidth();   // restart cleanly at the new size
    char b[40]; snprintf(b, sizeof(b), "ok (%d px)", v);
    out.writeln(b);
}

extern "C" void commander_setup(CommandRegistry& reg) {
    commander_register_modules(reg);
    reg.registerCommand(CMD("marquee", "scroll a message across all six displays", I2C_NONE, cmd_marquee, nullptr));
    reg.registerCommand(CMD("read",    "vertical-scroll a long message up a panel", I2C_NONE, cmd_read,   nullptr));
    reg.registerCommand(CMD("hscroll", "horizontal-scroll one line across a panel", I2C_NONE, cmd_hscroll, nullptr));
    reg.registerCommand(CMD("clock",   "return the displays to the clock face",    I2C_NONE, cmd_clock,   nullptr));
    reg.registerCommand(CMD("news",    "headlines marquee ('news fetch' refreshes)", I2C_NONE, cmd_news,   nullptr));
    reg.registerCommand(CMD("panel5",  "panel 5 content: weather or news",         I2C_NONE, cmd_panel5,  nullptr));
    reg.registerCommand(CMD("weather", "show/fetch weather ('weather raw' debugs)", I2C_NONE, cmd_weather, nullptr));
    reg.registerCommand(CMD("rotate",  "timed scene rotation on/off (clock<->news)", I2C_NONE, cmd_rotate, nullptr));
    reg.registerCommand(CMD("hold",    "yield displays for external pushes",       I2C_NONE, cmd_hold,    nullptr));
    reg.registerCommand(CMD("face",    "clock digits: png (flip-clock) or font",   I2C_NONE, cmd_face,    nullptr));
    reg.registerCommand(CMD("tune",    "font-clock layout offsets (bare = print)", I2C_NONE, cmd_tune,    nullptr));
    reg.registerCommand(CMD("mode",    "show the active display scene",            I2C_NONE, cmd_mode,    nullptr));
    reg.registerCommand(CMD("mspeed",  "marquee scroll speed in px/frame",         I2C_NONE, cmd_mspeed,  nullptr));
    reg.registerCommand(CMD("msize",   "marquee font height in px (fps trade)",    I2C_NONE, cmd_msize,   nullptr));
}

// SNTP keeps the system clock (UTC) synced; every NTP_RESYNC_MS we convert to
// local time and write it to the DS1302 so it stays accurate and survives
// reboots / WiFi outages.
static void ntp_task(void *) {
    setenv("TZ", CLOCK_TZ, 1);
    tzset();
    esp_sntp_config_t cfg = ESP_NETIF_SNTP_DEFAULT_CONFIG(NTP_SERVER);
    esp_netif_sntp_init(&cfg);
    for (;;) {
        if (esp_netif_sntp_sync_wait(pdMS_TO_TICKS(20000)) == ESP_OK) {
            time_t now = time(nullptr);
            struct tm lt;
            localtime_r(&now, &lt);
            RtcTime t;
            t.year    = lt.tm_year + 1900;
            t.month   = lt.tm_mon + 1;
            t.day     = lt.tm_mday;
            t.hour    = lt.tm_hour;
            t.minute  = lt.tm_min;
            t.second  = lt.tm_sec;
            t.weekday = lt.tm_wday + 1;        // tm_wday 0=Sun -> DS1302 1=Sun
            xSemaphoreTake(s_rtc_lock, portMAX_DELAY);
            s_rtc->setTime(t);
            xSemaphoreGive(s_rtc_lock);
        }
        vTaskDelay(pdMS_TO_TICKS(NTP_RESYNC_MS));
    }
}

// GTS Root R4 (Google Trust Services) — newsapi.org's root CA, which the esp_crt
// bundle doesn't match. Embedded via EMBED_TXTFILES so the news fetch verifies
// TLS against this specific root instead.
extern const char kGtsRootR4[] asm("_binary_gts_root_r4_pem_start");

// Fetch a short text body via HTTPS into `out`. Returns true on a non-empty read.
// ca_pem != null verifies the server cert against that specific root; otherwise
// against the esp_crt_bundle. Either way the server certificate IS verified.
static bool http_get_text(const char *url, char *out, int out_sz, const char *ca_pem) {
    esp_http_client_config_t cfg = {};
    cfg.url               = url;
    cfg.timeout_ms        = 8000;
    cfg.user_agent        = "cmdr-ipstube/1.0";       // newsapi rejects requests with no UA
    if (ca_pem) cfg.cert_pem          = ca_pem;                  // verify against this root
    else        cfg.crt_bundle_attach = esp_crt_bundle_attach;   // verify against the bundle
    esp_http_client_handle_t c = esp_http_client_init(&cfg);
    if (!c) return false;
    int total = 0;
    if (esp_http_client_open(c, 0) == ESP_OK) {
        esp_http_client_fetch_headers(c);
        while (total < out_sz - 1) {
            int n = esp_http_client_read(c, out + total, out_sz - 1 - total);
            if (n <= 0) break;
            total += n;
        }
    }
    out[total] = '\0';
    esp_http_client_close(c);
    esp_http_client_cleanup(c);
    return total > 0;
}

// Polls wttr.in (format "%t,%C" → e.g. "+72°F,Sunny") and publishes "NN°F Cond"
// to s_weather; the clock scene redraws panel 5 when s_weather_new is set. The
// degree byte is written as Latin-1 \xb0 so our byte-as-codepoint renderer shows °.
// Copy a JSON string value (stops at the closing quote) into dst.
static void json_str(const char *p, char *dst, int dst_sz) {
    int j = 0;
    while (*p && *p != '"' && j < dst_sz - 1) dst[j++] = *p++;
    dst[j] = '\0';
}

// Read the next item of a JSON array into dst, advancing *pp. false at ']' / end.
static bool array_next(const char **pp, char *dst, int dst_sz) {
    const char *p = *pp;
    while (*p == ' ' || *p == '\n' || *p == '\t' || *p == '\r' || *p == ',') ++p;
    if (*p == ']' || *p == '\0') { *pp = p; return false; }
    int j = 0;
    if (*p == '"') {
        ++p;
        while (*p && *p != '"' && j < dst_sz - 1) dst[j++] = *p++;
        if (*p == '"') ++p;
    } else {                                   // null / unquoted number
        while (*p && *p != ',' && *p != ']' && j < dst_sz - 1) dst[j++] = *p++;
    }
    dst[j] = '\0';
    *pp = p;
    return true;
}

// Forecast high/low from the MapClick parallel arrays time.tempLabel[] (High/Low)
// and data.temperature[]. -999 if not found.
static void parse_hilo(const char *resp, int *hi, int *lo) {
    *hi = -999; *lo = -999;
    const char *lp = strstr(resp, "\"tempLabel\"");
    const char *tp = strstr(resp, "\"temperature\"");
    if (!lp || !tp) return;
    while (*lp && *lp != '[') ++lp;
    while (*tp && *tp != '[') ++tp;
    if (*lp != '[' || *tp != '[') return;
    ++lp; ++tp;
    for (int i = 0; i < 8; ++i) {
        char lab[8], val[8];
        if (!array_next(&lp, lab, sizeof(lab))) break;
        if (!array_next(&tp, val, sizeof(val))) break;
        if (strcmp(lab, "High") == 0 && *hi == -999) *hi = atoi(val);
        if (strcmp(lab, "Low")  == 0 && *lo == -999) *lo = atoi(val);
        if (*hi != -999 && *lo != -999) break;
    }
}

// Fetch current conditions from forecast.weather.gov (NWS MapClick JSON, one GET):
// temperature from currentobservation.Temp, condition from there or the current
// forecast period. Verified via the cert bundle (Let's Encrypt root).
static void weather_fetch() {
    char url[128];
    snprintf(url, sizeof(url),
             "https://forecast.weather.gov/MapClick.php?lat=%s&lon=%s&FcstType=json",
             WEATHER_LAT, WEATHER_LON);
    const int cap = 32768;
    char *resp = (char *)heap_caps_malloc(cap, MALLOC_CAP_SPIRAM | MALLOC_CAP_8BIT);
    if (!resp) return;
    if (http_get_text(url, resp, cap, nullptr)) {
        // raw debug: the forecast data.weather region (where the condition comes from)
        const char *dbg = strstr(resp, "\"weather\"");
        const char *src = dbg ? dbg : resp;
        int rj = 0;
        for (const char *r = src; *r && rj < (int)sizeof(s_weather_raw) - 1; ++r) {
            unsigned char c = (unsigned char)*r;
            s_weather_raw[rj++] = (c >= 0x20 && c <= 0x7E) ? (char)c : ' ';
        }
        s_weather_raw[rj] = '\0';

        const char *tp = strstr(resp, "\"Temp\":\"");
        char tnum[8] = "";
        if (tp) json_str(tp + 8, tnum, sizeof(tnum));
        if (tnum[0] == '-' || (tnum[0] >= '0' && tnum[0] <= '9')) {   // valid reading
            int temp = atoi(tnum);
            char cond[24] = "";
            const char *wp = strstr(resp, "\"Weather\":\"");           // current obs condition
            if (wp) json_str(wp + 11, cond, sizeof(cond));
            if (cond[0] == '\0' || strcmp(cond, "NA") == 0) {         // fall back to data.weather[0]
                cond[0] = '\0';
                const char *dw = strstr(resp, "\"weather\"");          // tolerate whitespace/null
                if (dw) {
                    dw += 9;
                    while (*dw && *dw != '[' && *dw != '}') ++dw;
                    if (*dw == '[') {
                        ++dw;
                        while (*dw == ' ' || *dw == '\n' || *dw == '\t' || *dw == '\r') ++dw;
                        if (*dw == '"') json_str(dw + 1, cond, sizeof(cond));
                    }
                }
            }
            if (strcmp(cond, "NA") == 0) cond[0] = '\0';
            int hi, lo;
            parse_hilo(resp, &hi, &lo);
            // Lay out as lines (wrap_lines honors '\n'): temp / condition / hi-lo.
            int bl = snprintf(s_weather, sizeof(s_weather), "%d\xb0" "F", temp);
            if (cond[0])
                bl += snprintf(s_weather + bl, sizeof(s_weather) - bl, "\n%s", cond);
            if (hi > -900 && lo > -900)   // no-wrap line so "49° / 71°" stays together
                snprintf(s_weather + bl, sizeof(s_weather) - bl, "\n%c%d\xb0 / %d\xb0",
                         IpstubeModule::kNoWrap, lo, hi);
            else if (hi > -900)
                snprintf(s_weather + bl, sizeof(s_weather) - bl, "\n%d\xb0", hi);
            else if (lo > -900)
                snprintf(s_weather + bl, sizeof(s_weather) - bl, "\n%d\xb0", lo);
            s_weather_new = true;
        }
    }
    free(resp);
}

// Refresh weather every WEATHER_REFRESH_MS (or immediately on `weather fetch`).
static void weather_task(void *) {
    vTaskDelay(pdMS_TO_TICKS(3500));   // let WiFi settle
    weather_fetch();
    uint32_t since = 0;
    for (;;) {
        vTaskDelay(pdMS_TO_TICKS(1000));
        since += 1000;
        if (s_weather_fetch_now || since >= WEATHER_REFRESH_MS) {
            s_weather_fetch_now = false;
            since = 0;
            weather_fetch();
        }
    }
}

// Fetch top headlines from newsapi.org and join the titles into s_news. We pull
// the "title":"..." values directly (no JSON lib): decode the common backslash
// escapes and keep only printable ASCII (our renderer can't show UTF-8).
static void news_fetch() {
    char url[176];
    snprintf(url, sizeof(url),
             "https://newsapi.org/v2/top-headlines?country=us&pageSize=%d&apiKey=%s",
             NEWS_COUNT, NEWSAPI_KEY);
    const int cap = 16384;
    char *resp = (char *)heap_caps_malloc(cap, MALLOC_CAP_SPIRAM | MALLOC_CAP_8BIT);
    if (!resp) return;
    if (http_get_text(url, resp, cap, kGtsRootR4)) {   // verify newsapi against GTS Root R4
        // Stash the start of the response for `news raw` debugging.
        int rj = 0;
        for (const char *r = resp; *r && rj < (int)sizeof(s_news_raw) - 1; ++r) {
            unsigned char c = (unsigned char)*r;
            s_news_raw[rj++] = (c >= 0x20 && c <= 0x7E) ? (char)c : ' ';
        }
        s_news_raw[rj] = '\0';

        char acc[1024];
        int  al = 0, count = 0;
        const char *p = resp;
        while ((p = strstr(p, "\"title\":\"")) != nullptr && count < NEWS_COUNT && al < (int)sizeof(acc) - 48) {
            p += 9;                          // past "title":"
            if (al > 0) {
                const char *sep = "    *    ";
                int sl = (int)strlen(sep);
                memcpy(acc + al, sep, sl);
                al += sl;
            }
            while (*p && *p != '"' && al < (int)sizeof(acc) - 1) {
                if (*p == '\\') {
                    ++p;
                    if      (*p == '"' || *p == '\\' || *p == '/') acc[al++] = *p++;
                    else if (*p == 'n' || *p == 't'  || *p == 'r') { acc[al++] = ' '; ++p; }
                    else if (*p == 'u') { for (int k = 0; k < 5 && *p; ++k) ++p; }   // skip \uXXXX
                    else if (*p) ++p;                                                // drop unknown
                } else {
                    unsigned char c = (unsigned char)*p++;
                    if (c >= 0x20 && c <= 0x7E) acc[al++] = (char)c;                 // ASCII only
                }
            }
            ++count;
        }
        acc[al] = '\0';
        if (al > 0) {
            strncpy(s_news, acc, sizeof(s_news) - 1);
            s_news[sizeof(s_news) - 1] = '\0';
            s_news_new = true;
            s_p5_dirty = true;
        }
    }
    free(resp);
}

// Refresh headlines hourly (or immediately on `news fetch`).
static void news_task(void *) {
    vTaskDelay(pdMS_TO_TICKS(4000));   // let WiFi settle
    news_fetch();
    uint32_t since = 0;
    for (;;) {
        vTaskDelay(pdMS_TO_TICKS(1000));
        since += 1000;
        if (s_news_fetch_now || since >= NEWS_REFRESH_MS) {
            s_news_fetch_now = false;
            since = 0;
            news_fetch();
        }
    }
}

// Timed scene rotation (D1): clock → news marquee → clock, while `rotate on`.
static void rotation_task(void *) {
    int idx = 0;
    for (;;) {
        if (!s_rotate) {
            idx = 0;
            vTaskDelay(pdMS_TO_TICKS(500));
            continue;
        }
        scene_request(idx == 0 ? &kSceneClock : &kSceneNews);
        int secs = (idx == 0) ? ROTATE_CLOCK_SECS : ROTATE_NEWS_SECS;
        for (int e = 0; e < secs && s_rotate; ++e) vTaskDelay(pdMS_TO_TICKS(1000));
        idx ^= 1;
    }
}

// Hooks fire in registration order (ds1302 before ipstube), so the RTC reference
// is set by the time the display is ready — start the scene runner then.
extern "C" void commander_on_ds1302_ready(Ds1302Module &rtc) {
    s_rtc = &rtc;
}

// Karla-Regular.ttf, embedded via main/CMakeLists.txt EMBED_FILES. The text API
// (drawText / scrolls) renders from this; the bitmap clock is unaffected.
extern const uint8_t kFontStart[] asm("_binary_Karla_Regular_ttf_start");
extern const uint8_t kFontEnd[]   asm("_binary_Karla_Regular_ttf_end");

extern "C" void commander_on_ipstube_ready(IpstubeModule &disp) {
    s_disp = &disp;
    disp.loadFont(kFontStart, (size_t)(kFontEnd - kFontStart));
    disp.setBrightness(CLOCK_BRIGHTNESS);   // dim by default (init() came up at full)
    s_rtc_lock = xSemaphoreCreateMutex();
    scene_request(&kSceneClock);            // boot into the clock scene
    xTaskCreate(scene_runner,   "scene",  4096, nullptr, 4, nullptr);
    xTaskCreate(rotation_task,  "rotate", 2048, nullptr, 3, nullptr);  // idle until `rotate on`
}

// Runner calls this once WiFi is up — start NTP then (no WiFi → RTC just free-runs).
extern "C" void commander_on_wifi_connected() {
    static bool started = false;
    if (started) return;
    started = true;
    xTaskCreate(ntp_task,     "ntp",     4096,  nullptr, 3, nullptr);
    xTaskCreate(weather_task, "weather", 10240, nullptr, 3, nullptr);   // TLS + JSON parse
    xTaskCreate(news_task,    "news",    10240, nullptr, 3, nullptr);   // TLS + cJSON parse
}
